## templates/buildroot/configs/copyos_defconfig
```kconfig
# CopyOS Buildroot Defconfig
BR2_x86_64=y
BR2_x86_32=y
BR2_TOOLCHAIN_BUILDROOT_GLIBC=y
BR2_KERNEL_HEADERS_6_6=y
BR2_LINUX_KERNEL=y
BR2_LINUX_KERNEL_CUSTOM_VERSION=y
BR2_LINUX_KERNEL_CUSTOM_VERSION_VALUE="6.6.21"
BR2_LINUX_KERNEL_USE_DEFCONFIG=y
BR2_LINUX_KERNEL_DEFCONFIG="x86_64"
BR2_LINUX_KERNEL_VMLINUX=y
BR2_TARGET_GENERIC_HOSTNAME="copyos"
BR2_TARGET_GENERIC_ISSUE="Willkommen bei CopyOS"
BR2_INIT_BUSYBOX=y
BR2_PACKAGE_BUSYBOX_CONFIG_FRAGMENT_FILES="board/copyos/busybox.fragment"
BR2_SYSTEM_DHCP="eth0"
BR2_ENABLE_LOCALE_PURGE=n
BR2_PACKAGE_DIALOG=y
BR2_PACKAGE_RSYNC=y
BR2_PACKAGE_E2FSPROGS=y
BR2_PACKAGE_E2FSPROGS_MKE2FS=y
BR2_PACKAGE_DOSFSTOOLS=y
BR2_PACKAGE_NTFS_3G=y
BR2_PACKAGE_LVM2=y
BR2_PACKAGE_GPTFDISK=y
BR2_PACKAGE_UTIL_LINUX_PARTX=y
BR2_PACKAGE_UTIL_LINUX_LSBLK=y
BR2_PACKAGE_UTIL_LINUX_LSMEM=y
BR2_PACKAGE_UTIL_LINUX_WIPEFS=y
BR2_PACKAGE_COREUTILS=y
BR2_PACKAGE_FINCH=n
BR2_PACKAGE_PYTHON3=y
BR2_PACKAGE_PYTHON3_PY_PYC=y
BR2_PACKAGE_PYTHON3_READLINE=y
BR2_PACKAGE_PYTHON3_ZLIB=y
BR2_PACKAGE_JQ=y
BR2_PACKAGE_ESPEAKUP=y
BR2_PACKAGE_TMUX=y
BR2_PACKAGE_BASH=y
BR2_PACKAGE_NANO=y
BR2_ROOTFS_OVERLAY="board/copyos/rootfs-overlay"
BR2_ROOTFS_POST_BUILD_SCRIPT="board/copyos/post-build.sh"
BR2_TARGET_ROOTFS_EXT2=y
BR2_TARGET_ROOTFS_EXT2_4=y
BR2_TARGET_ROOTFS_SQUASHFS=y
BR2_TARGET_ROOTFS_TAR=y
BR2_PACKAGE_HOST_GENIMAGE=y
BR2_PACKAGE_HOST_DOSFSTOOLS=y
BR2_PACKAGE_HOST_MTOOLS=y
```
